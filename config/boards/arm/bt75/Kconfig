## config/boards/arm/bt75/Kconfig
```kconfig
# SPDX-License-Identifier: MIT

config BOARD_ENABLE_DCDC
	bool "Enable DCDC mode"
	select SOC_DCDC_NRF52X
	default y
	depends on BOARD_BT75

config ZMK_IDLE_TIMEOUT
	int "Milliseconds of inactivity before entering idle state (OLED shutoff, etc)"
	default 30000

config ZMK_SLEEP
	bool "Enable deep sleep support"
	imply USB

if ZMK_SLEEP

config PM_DEVICE
	default y

config ZMK_IDLE_SLEEP_TIMEOUT
	int "Milliseconds of inactivity before entering deep sleep"
	default 900000

#ZMK_SLEEP
endif
```

## config/boards/arm/bt75/Kconfig.defconfig
```kconfig
# Copyright (c) 2021 Polarity Works
# SPDX-License-Identifier: MIT

if BOARD_BT75

config BOARD
	default "bt75"

if USB

config USB_NRFX
	default y

config USB_DEVICE_STACK
	default y

endif # USB

config BT_CTLR
	default BT

config ZMK_BLE
	default y

config ZMK_USB
	default y

config ZMK_BATTERY_VOLTAGE_DIVIDER
	default y

config ZMK_KEYBOARD_NAME
	default "BT75"
	
config ZMK_IDLE_TIMEOUT
	int "Milliseconds of inactivity before entering idle state (OLED shutoff, etc)"
	default 30000

config ZMK_SLEEP
	bool "Enable deep sleep support"
	imply USB

if ZMK_SLEEP

config PM_DEVICE
	default y

config ZMK_IDLE_SLEEP_TIMEOUT
	int "Milliseconds of inactivity before entering deep sleep"
	default 900000

#ZMK_SLEEP
endif

endif # BOARD_BT75
```
